## config/west.yml
```yaml
manifest:
  remotes:
    - name: zmkfirmware
      url-base: https://github.com/zmkfirmware
    - name: nickconway
      url-base: https://github.com/nickconway
  projects:
    - name: zmk
      remote: nickconway # zmkfirmware
      revision: dynamic-macro # main
      import: app/west.yml
  self:
    path: config
```
